// ================================================================
// main.cpp  –  certificate uploader / inspector for SIM7670C/A7670C
//
// PURPOSE
//   Writes the 3 AWS IoT files (Root CA, client cert, client key) into
//   the MODEM's own internal filesystem using AT+CCERTDOWN, and reports
//   exactly what ended up there.
//
//   This is a RECOVERY TOOL, not a required step. The main firmware
//   calls at_mqtt_provision_certs() on every connect attempt and
//   uploads these same files itself whenever the modem's store is
//   missing or stale, so the normal workflow is simply: flash the main
//   firmware. Use this sketch to inspect a modem's store, to clear it,
//   or to provision a module that is not yet wired to a meter.
//
//   The certificates come from ../certs/<custom_cert_device>/ via the
//   generated certs_generated.h, and the filenames from the main
//   firmware's config.h. Both are shared with the firmware — there is
//   no second copy to keep in sync.
//
// HOW TO USE
//   1. pio run -t upload      (from this directory)
//   2. Serial monitor at 115200
//   3. Look for "ALL CERTIFICATES VERIFIED ON MODEM"
//   4. Flash the main firmware
//
// AT+CCERTDOWN syntax (A76XX AT Command Manual, Ch.19.2.2):
//   AT+CCERTDOWN=<filename>,<len>
//   >                                <- modem prompt
//   <raw file bytes, exactly len>    <- we send this
//   OK                               <- confirms write succeeded
// ================================================================

#include <Arduino.h>
#include "config.h"             // shared with energy_meter_2_firmware
#include "certs_generated.h"    // generated by ../energy_meter_2_firmware/scripts/gen_certs.py

static HardwareSerial gsm(1);

// ────────────────────────────────────────────────────────────────
// _read_line() — same pattern as the main firmware's at_mqtt.cpp
// ────────────────────────────────────────────────────────────────
static bool _read_line(char* out, size_t outLen, uint32_t timeoutMs) {
    size_t   pos      = 0;
    uint32_t deadline = millis() + timeoutMs;

    while (millis() < deadline) {
        while (gsm.available()) {
            char c = (char)gsm.read();
            if (c == '\n') {
                out[pos] = '\0';
                if (pos > 0) {
                    DBG("[AT] << ");
                    DBGLN(out);
                    return true;
                }
                pos = 0;
            } else if (c != '\r') {
                if (pos < outLen - 1) out[pos++] = c;
            }
        }
        delay(2);
    }
    return false;
}

static bool _at_cmd(const char* cmd, uint32_t timeoutMs) {
    while (gsm.available()) gsm.read();
    DBG("[AT] >> "); DBGLN(cmd);
    gsm.print(cmd);
    gsm.print("\r\n");

    char line[256];
    uint32_t deadline = millis() + timeoutMs;
    while (millis() < deadline) {
        if (_read_line(line, sizeof(line), 200)) {
            if (strstr(line, "OK")) return true;
            if (strstr(line, "ERROR")) return false;
        }
    }
    DBGLN("[AT] Timeout");
    return false;
}

// ────────────────────────────────────────────────────────────────
// _cert_list()
//
// Runs AT+CCERTLIST and reports which of our three filenames are
// actually present. The previous version of this sketch printed the
// listing but never read it, so "UPLOADED SUCCESSFULLY" only meant the
// modem had said OK three times — it could not tell you that a file
// was missing. Every success claim below is now gated on this.
//
// Note the limit: CCERTLIST reports NAMES ONLY, never content. It can
// prove a file exists; it cannot prove it is the right certificate.
// That is what the fingerprint printed at startup is for, and what the
// main firmware tracks in NVS.
// ────────────────────────────────────────────────────────────────
static bool _cert_list(bool* haveCa, bool* haveCert, bool* haveKey) {
    *haveCa = *haveCert = *haveKey = false;

    while (gsm.available()) gsm.read();
    DBGLN("[AT] >> AT+CCERTLIST");
    gsm.print("AT+CCERTLIST\r\n");

    bool done = false;
    char line[256];
    uint32_t deadline = millis() + 5000;
    while (millis() < deadline && !done) {
        if (!_read_line(line, sizeof(line), 200)) continue;
        if (strstr(line, CERT_FILENAME_CA))   *haveCa   = true;
        if (strstr(line, CERT_FILENAME_CERT)) *haveCert = true;
        if (strstr(line, CERT_FILENAME_KEY))  *haveKey  = true;
        if (strstr(line, "OK") || strstr(line, "ERROR")) done = true;
    }
    return done;
}

// ────────────────────────────────────────────────────────────────
// _delete_cert()
//
// AT+CCERTDELE=<filename> removes a previously-stored file before we
// write a fresh one; the modem will not overwrite in place. If the
// file doesn't exist the modem replies ERROR (AT Command Manual,
// Ch.19.2.4) — that is NOT a failure here, just "nothing to delete".
// ────────────────────────────────────────────────────────────────
static void _delete_cert(const char* filename) {
    char cmd[80];
    snprintf(cmd, sizeof(cmd), "AT+CCERTDELE=\"%s\"", filename);

    if (_at_cmd(cmd, 5000)) {
        DBGF("[CERT] Existing %s removed.\n", filename);
    } else {
        DBGF("[CERT] No existing %s to remove — continuing.\n", filename);
    }
}

// ────────────────────────────────────────────────────────────────
// _upload_cert()
//
// Sends AT+CCERTDOWN=<filename>,<len>, waits for the ">" prompt,
// writes the raw PEM bytes, then waits for OK.
// ────────────────────────────────────────────────────────────────
static bool _upload_cert(const char* filename, const char* data, size_t len) {
    char cmd[80];
    snprintf(cmd, sizeof(cmd), "AT+CCERTDOWN=\"%s\",%u", filename, (unsigned)len);

    while (gsm.available()) gsm.read();
    DBG("[AT] >> "); DBGLN(cmd);
    gsm.print(cmd);
    gsm.print("\r\n");

    bool gotPrompt = false;
    uint32_t deadline = millis() + 5000;
    while (millis() < deadline && !gotPrompt) {
        if (gsm.available() && (char)gsm.read() == '>') gotPrompt = true;
    }
    if (!gotPrompt) {
        DBGF("[CERT] '>' prompt not received for %s\n", filename);
        return false;
    }

    DBGF("[CERT] Writing %u bytes for %s...\n", (unsigned)len, filename);
    gsm.write((const uint8_t*)data, len);   // raw bytes, exact length
    gsm.flush();                            // drain TX before waiting on OK

    char line[256];
    deadline = millis() + 15000;            // flash write can take seconds
    while (millis() < deadline) {
        if (!_read_line(line, sizeof(line), 200)) continue;
        if (strstr(line, "OK"))    { DBGF("[CERT] %s written\n\n", filename); return true; }
        if (strstr(line, "ERROR")) break;
    }

    DBGF("[CERT] %s upload FAILED\n\n", filename);
    return false;
}

// ────────────────────────────────────────────────────────────────
void setup() {
    Serial.begin(115200);
    delay(500);

    DBGLN("================================================");
    DBGLN(" AWS IoT Certificate Uploader - SIM7670C/A7670C ");
    DBGLN("================================================");
    DBGF(" device      : %s\n", CERT_DEVICE_NAME);
    DBGF(" cert serial : %s\n", CLIENT_CERT_SERIAL);
    DBGF(" valid       : %s -> %s\n", CLIENT_CERT_NOT_BEFORE, CLIENT_CERT_NOT_AFTER);
    DBGF(" sha256      : %s\n", CLIENT_CERT_SHA256);
    DBGLN(" ^ compare this fingerprint against the AWS IoT console");
    DBGF(" files       : %s / %s / %s\n",
         CERT_FILENAME_CA, CERT_FILENAME_CERT, CERT_FILENAME_KEY);
    DBGF(" sizes       : %u / %u / %u bytes\n",
         (unsigned)ROOT_CA_PEM_LEN, (unsigned)CLIENT_CERT_PEM_LEN, (unsigned)CLIENT_KEY_PEM_LEN);
    DBGLN("================================================\n");

    gsm.begin(GSM_UART_BAUD, SERIAL_8N1, GSM_RX_PIN, GSM_TX_PIN);
    delay(300);

    if (GSM_PWRKEY_PIN >= 0) {
        pinMode(GSM_PWRKEY_PIN, OUTPUT);
        digitalWrite(GSM_PWRKEY_PIN, HIGH);
        delay(100);
        digitalWrite(GSM_PWRKEY_PIN, LOW);
        delay(1200);
        digitalWrite(GSM_PWRKEY_PIN, HIGH);
        delay(3000);
    }

    DBGLN("[INIT] Waking modem...");
    bool awake = false;
    for (int i = 0; i < 10 && !awake; i++) {
        awake = _at_cmd("AT", 2000);
        if (!awake) delay(1000);
    }
    if (!awake) {
        DBGLN("[INIT] FATAL: Modem not responding. Check wiring/power.");
        return;
    }
    _at_cmd("AT+CMEE=2", 2000);   // verbose errors
    DBGLN("[INIT] Modem awake.\n");

    // ── What is on there right now? ────────────────────────────────
    bool haveCa, haveCert, haveKey;
    DBGLN("[INFO] Certificates currently on modem:");
    _cert_list(&haveCa, &haveCert, &haveKey);
    DBGF("[INFO]   %s=%s  %s=%s  %s=%s\n\n",
         CERT_FILENAME_CA,   haveCa   ? "present" : "absent",
         CERT_FILENAME_CERT, haveCert ? "present" : "absent",
         CERT_FILENAME_KEY,  haveKey  ? "present" : "absent");

    // ── Remove old copies, then write fresh ones ───────────────────
    DBGLN("[INFO] Removing any previous copies before re-upload...");
    _delete_cert(CERT_FILENAME_CA);
    _delete_cert(CERT_FILENAME_CERT);
    _delete_cert(CERT_FILENAME_KEY);
    DBGLN("");

    bool ok1 = _upload_cert(CERT_FILENAME_CA,   ROOT_CA_PEM,     ROOT_CA_PEM_LEN);
    bool ok2 = _upload_cert(CERT_FILENAME_CERT, CLIENT_CERT_PEM, CLIENT_CERT_PEM_LEN);
    bool ok3 = _upload_cert(CERT_FILENAME_KEY,  CLIENT_KEY_PEM,  CLIENT_KEY_PEM_LEN);

    // ── Verify against the modem's own listing, not our own OKs ────
    DBGLN("[VERIFY] Re-reading the modem's certificate store:");
    bool listed = _cert_list(&haveCa, &haveCert, &haveKey);
    bool verified = listed && haveCa && haveCert && haveKey;

    DBGLN("\n================================================");
    if (ok1 && ok2 && ok3 && verified) {
        DBGLN(" ALL CERTIFICATES VERIFIED ON MODEM             ");
        DBGF ("   fingerprint %s\n", CLIENT_CERT_SHA256);
        DBGLN(" You can now flash the main firmware.           ");
    } else {
        DBGLN(" PROVISIONING FAILED - see log above            ");
        DBGF(" writes   CA:%s CERT:%s KEY:%s\n",
             ok1 ? "OK" : "FAILED", ok2 ? "OK" : "FAILED", ok3 ? "OK" : "FAILED");
        DBGF(" on modem CA:%s CERT:%s KEY:%s\n",
             haveCa   ? "present" : "ABSENT",
             haveCert ? "present" : "ABSENT",
             haveKey  ? "present" : "ABSENT");
        if (!listed) DBGLN(" (AT+CCERTLIST did not reply - modem may be wedged)");
    }
    DBGLN("================================================\n");
}

void loop() {
    // Nothing to do — this is a one-shot uploader.
    delay(10000);
}
